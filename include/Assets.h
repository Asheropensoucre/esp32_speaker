#ifndef ASSETS_H
#define ASSETS_H

#include <Arduino.h>

/**
 * Assets.h - Contains all visual assets for Sir Potato OS
 * 
 * This file contains:
 * - Font data (Minimal 39-character custom font)
 * - Sprite sheet arrays for Sir Potato animations
 * - WAV sound effects (Boot, Connect, Disconnect)
 * 
 * All assets are stored in PROGMEM to save RAM
 */

// ============================================================================
// MINIMAL CUSTOM FONT (39 characters)
// ============================================================================
// Characters: A-Z (26), 0-9 (10), space, dash, colon (3)
// Total: 39 characters
// Format: 8x8 pixel bitmap, stored in PROGMEM

// Character mapping (index 0-38):
// 0-25: A-Z
// 26-35: 0-9
// 36: space
// 37: dash
// 38: colon

const uint8_t customFont[][8] PROGMEM = {
    // A (0)
    {0x0C, 0x1E, 0x33, 0x33, 0x3F, 0x33, 0x33, 0x00},
    // B (1)
    {0x3F, 0x33, 0x33, 0x3E, 0x33, 0x33, 0x3F, 0x00},
    // C (2)
    {0x1E, 0x33, 0x03, 0x03, 0x03, 0x33, 0x1E, 0x00},
    // D (3)
    {0x3F, 0x33, 0x33, 0x33, 0x33, 0x33, 0x3F, 0x00},
    // E (4)
    {0x3F, 0x03, 0x03, 0x1E, 0x03, 0x03, 0x3F, 0x00},
    // F (5)
    {0x3F, 0x03, 0x03, 0x1E, 0x03, 0x03, 0x03, 0x00},
    // G (6)
    {0x1E, 0x33, 0x03, 0x33, 0x33, 0x33, 0x3E, 0x00},
    // H (7)
    {0x33, 0x33, 0x33, 0x3F, 0x33, 0x33, 0x33, 0x00},
    // I (8)
    {0x1E, 0x0C, 0x0C, 0x0C, 0x0C, 0x0C, 0x1E, 0x00},
    // J (9)
    {0x78, 0x30, 0x30, 0x30, 0x33, 0x33, 0x1E, 0x00},
    // K (10)
    {0x33, 0x33, 0x36, 0x3C, 0x36, 0x33, 0x33, 0x00},
    // L (11)
    {0x03, 0x03, 0x03, 0x03, 0x03, 0x33, 0x3F, 0x00},
    // M (12)
    {0x33, 0x3B, 0x3F, 0x33, 0x33, 0x33, 0x33, 0x00},
    // N (13)
    {0x33, 0x3B, 0x3B, 0x33, 0x33, 0x33, 0x33, 0x00},
    // O (14)
    {0x1E, 0x33, 0x33, 0x33, 0x33, 0x33, 0x1E, 0x00},
    // P (15)
    {0x3E, 0x33, 0x33, 0x3E, 0x03, 0x03, 0x03, 0x00},
    // Q (16)
    {0x1E, 0x33, 0x33, 0x33, 0x33, 0x1E, 0x38, 0x00},
    // R (17)
    {0x3E, 0x33, 0x33, 0x3E, 0x36, 0x33, 0x33, 0x00},
    // S (18)
    {0x1E, 0x33, 0x07, 0x1E, 0x38, 0x33, 0x1E, 0x00},
    // T (19)
    {0x3F, 0x0C, 0x0C, 0x0C, 0x0C, 0x0C, 0x0C, 0x00},
    // U (20)
    {0x33, 0x33, 0x33, 0x33, 0x33, 0x33, 0x1E, 0x00},
    // V (21)
    {0x33, 0x33, 0x33, 0x33, 0x33, 0x1E, 0x0C, 0x00},
    // W (22)
    {0x33, 0x33, 0x33, 0x33, 0x3B, 0x3F, 0x33, 0x00},
    // X (23)
    {0x33, 0x33, 0x1E, 0x0C, 0x1E, 0x33, 0x33, 0x00},
    // Y (24)
    {0x33, 0x33, 0x33, 0x1E, 0x0C, 0x0C, 0x0C, 0x00},
    // Z (25)
    {0x7F, 0x33, 0x0F, 0x0E, 0x38, 0x30, 0x7F, 0x00},
    // 0 (26)
    {0x3E, 0x63, 0x73, 0x7B, 0x6F, 0x67, 0x3E, 0x00},
    // 1 (27)
    {0x0C, 0x0E, 0x0C, 0x0C, 0x0C, 0x0C, 0x3F, 0x00},
    // 2 (28)
    {0x1E, 0x33, 0x30, 0x1C, 0x06, 0x33, 0x3F, 0x00},
    // 3 (29)
    {0x1E, 0x33, 0x30, 0x1C, 0x30, 0x33, 0x1E, 0x00},
    // 4 (30)
    {0x38, 0x3C, 0x36, 0x33, 0x7F, 0x30, 0x78, 0x00},
    // 5 (31)
    {0x3F, 0x03, 0x1F, 0x30, 0x30, 0x33, 0x1E, 0x00},
    // 6 (32)
    {0x1C, 0x06, 0x03, 0x1F, 0x33, 0x33, 0x1E, 0x00},
    // 7 (33)
    {0x7F, 0x63, 0x30, 0x18, 0x0C, 0x0C, 0x0C, 0x00},
    // 8 (34)
    {0x3E, 0x33, 0x33, 0x3E, 0x33, 0x33, 0x3E, 0x00},
    // 9 (35)
    {0x3E, 0x33, 0x33, 0x3E, 0x30, 0x18, 0x0E, 0x00},
    // space (36)
    {0x00, 0x00, 0x00, 0x00, 0x00, 0x00, 0x00, 0x00},
    // dash (37)
    {0x00, 0x00, 0x00, 0x3F, 0x00, 0x00, 0x00, 0x00},
    // colon (38)
    {0x00, 0x00, 0x18, 0x18, 0x00, 0x18, 0x18, 0x00}
};

// Font dimensions
#define FONT_WIDTH 8
#define FONT_HEIGHT 8

// Helper function to get character index from ASCII
inline int getFontIndex(char c) {
    if (c >= 'A' && c <= 'Z') return c - 'A';
    if (c >= 'a' && c <= 'z') return c - 'a';  // Support lowercase too
    if (c >= '0' && c <= '9') return 26 + (c - '0');
    if (c == ' ') return 36;
    if (c == '-') return 37;
    if (c == ':') return 38;
    return 36;  // Default to space for unknown characters
}

// ============================================================================
// SPRITE SHEET DATA (16 frames, 120x120 pixels each)
// ============================================================================

// Sprite data is now in test/sprite_data.h
// This file contains raw RGB565 sprite frames (no compression)

// Sprite dimensions
#define SPRITE_WIDTH 120
#define SPRITE_HEIGHT 120
#define SPRITE_FRAMES 16

// External declaration for sprite sheet (defined in sprite_data.h)
extern const uint16_t* spriteSheet[16];

// ============================================================================
// SOUND EFFECTS (WAV format)
// ============================================================================

// TODO: Convert WAV files to C-arrays
// Boot sound, Connect sound, Disconnect sound

const uint8_t bootSound[] PROGMEM = {
    // Placeholder for boot sound
};

const uint8_t connectSound[] PROGMEM = {
    // Placeholder for connect sound
};

const uint8_t disconnectSound[] PROGMEM = {
    // Placeholder for disconnect sound
};

#endif // ASSETS_H
